## boards/shields/split50_19/Kconfig.shield
```kconfig
config SHIELD_SPLIT50_19_LEFT
    def_bool $(shields_list_contains,split50_19_left)
config SHIELD_SPLIT50_19_RIGHT
    def_bool $(shields_list_contains,split50_19_right)
```

## split50_19-akdk/boards/shields/split50_19/Kconfig.defconfig
```kconfig
if SHIELD_SPLIT50_19_RIGHT

config ZMK_KEYBOARD_NAME
    default "split50_19"

endif

if SHIELD_SPLIT50_19_LEFT || SHIELD_SPLIT50_19_RIGHT

config ZMK_SPLIT
    default y

endif
```
